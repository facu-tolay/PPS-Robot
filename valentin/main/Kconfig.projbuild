## valentin/main/Kconfig.projbuild
```kconfig
menu "Robot Settings"
    config WIFI_SSID
        string "Wifi network name"
        default ""
        help
            Type the Wifi network SSID.
    config WIFI_PASS
        string "Wifi network password"
        default ""
        help
            Type the Wifi network password.
    config BROKER_HOST
        string "MQTT broker hostname"
        default "192.168.0.40"
        help
            Type the MQTT broker hostname.

    config BROKER_PORT
        int "MQTT broker port"
        default 1883
        help
            Type the MQTT broker port.

    config ROBOT_ID
        string "Unique ID for the robot"
        default "ROB_C"
        help
            Type the robot id that you want to use.

endmenu
```
